## sdkconfig.defaults
```kconfig
# Overrides para DroneShow — el resto queda en defaults de ESP-IDF.

# WebSocket server (Fase 0)
CONFIG_HTTPD_WS_SUPPORT=y

# Headers de browsers modernos no entran en 512 por default — agrando.
CONFIG_HTTPD_MAX_REQ_HDR_LEN=2048
CONFIG_HTTPD_MAX_URI_LEN=512

# Resolucion del scheduler — control loop pide >100Hz
CONFIG_FREERTOS_HZ=1000

# Margen de stack para app_main
CONFIG_ESP_MAIN_TASK_STACK_SIZE=4096

# Logs en INFO por default
CONFIG_LOG_DEFAULT_LEVEL_INFO=y
```
